#include <Keypad.h>
#define NOTE_D0 -1
#define NOTE_D1 294
#define NOTE_D2 330
#define NOTE_D3 350
#define NOTE_D4 393
#define NOTE_D5 441
#define NOTE_D6 495
#define NOTE_D7 556

#define NOTE_DL1 147
#define NOTE_DL2 165
#define NOTE_DL3 175
#define NOTE_DL4 196
#define NOTE_DL5 221
#define NOTE_DL6 248
#define NOTE_DL7 278

#define NOTE_DH1 589
#define NOTE_DH2 661
#define NOTE_DH3 700
#define NOTE_DH4 786
#define NOTE_DH5 882
#define NOTE_DH6 990
#define NOTE_DH7 112
//对应音调
#define WHOLE 1
#define HALF 0.5
#define QUARTER 0.25
#define EIGHTH 0.25
#define SIXTEENTH 0.625
//英文对应了拍子


short tune[] =
{
    NOTE_D0,NOTE_D0,NOTE_D0,NOTE_D6,NOTE_D7,NOTE_DH1,NOTE_D7,NOTE_DH1,NOTE_DH3,NOTE_D7,NOTE_D7,NOTE_D7,NOTE_D3,NOTE_D3,
    NOTE_D6,NOTE_D5,NOTE_D6,NOTE_DH1,NOTE_D5,NOTE_D5,NOTE_D5,NOTE_D3,NOTE_D4,NOTE_D3,NOTE_D4,NOTE_DH1,
    NOTE_D3,NOTE_D3,NOTE_D0,NOTE_DH1,NOTE_DH1,NOTE_DH1,NOTE_D7,NOTE_D4,NOTE_D4,NOTE_D7,NOTE_D7,NOTE_D7,NOTE_D0,NOTE_D6,NOTE_D7,
    NOTE_DH1,NOTE_D7,NOTE_DH1,NOTE_DH3,NOTE_D7,NOTE_D7,NOTE_D7,NOTE_D3,NOTE_D3,NOTE_D6,NOTE_D5,NOTE_D6,NOTE_DH1,
    NOTE_D5,NOTE_D5,NOTE_D5,NOTE_D2,NOTE_D3,NOTE_D4,NOTE_DH1,NOTE_D7,NOTE_D7,NOTE_DH1,NOTE_DH1,NOTE_DH2,NOTE_DH2,NOTE_DH3,NOTE_DH1,NOTE_DH1,NOTE_DH1,
    NOTE_DH1,NOTE_D7,NOTE_D6,NOTE_D6,NOTE_D7,NOTE_D5,NOTE_D6,NOTE_D6,NOTE_D6,NOTE_DH1,NOTE_DH2,NOTE_DH3,NOTE_DH2,NOTE_DH3,NOTE_DH5,
    NOTE_DH2,NOTE_DH2,NOTE_DH2,NOTE_D5,NOTE_D5,NOTE_DH1,NOTE_D7,NOTE_DH1,NOTE_DH3,NOTE_DH3,NOTE_DH3,NOTE_DH3,NOTE_DH3,
    NOTE_D6,NOTE_D7,NOTE_DH1,NOTE_D7,NOTE_DH2,NOTE_DH2,NOTE_DH1,NOTE_D5,NOTE_D5,NOTE_D5,NOTE_DH4,NOTE_DH3,NOTE_DH2,NOTE_DH1,
    NOTE_DH3,NOTE_DH3,NOTE_DH3,NOTE_DH3,NOTE_DH6,NOTE_DH6,NOTE_DH5,NOTE_DH5,NOTE_DH3,NOTE_DH2,NOTE_DH1,NOTE_DH1,NOTE_D0,NOTE_DH1,
    NOTE_DH2,NOTE_DH1,NOTE_DH2,NOTE_DH2,NOTE_DH5,NOTE_DH3,NOTE_DH3,NOTE_DH3,NOTE_DH3,NOTE_DH6,NOTE_DH6,NOTE_DH5,NOTE_DH5,
    NOTE_DH3,NOTE_DH2,NOTE_DH1,NOTE_DH1,NOTE_D0,NOTE_DH1,NOTE_DH2,NOTE_DH1,NOTE_DH2,NOTE_DH2,NOTE_D7,NOTE_D6,NOTE_D6,NOTE_D6,NOTE_D6,NOTE_D7
};

float duration[]=

{
    1,1,1,0.5,0.5,     1+0.5,0.5,1,1,     1,1,1,0.5,0.5,
    1+0.5,0.5,1,1,     1,1,1,1,          1+0.5,0.5,1,1,
    1,1,0.5,0.5,0.5,0.5,    1+0.5,0.5,1,1,     1,1,1,0.5,0.5,
    1+0.5,0.5,1,1,    1,1,1,0.5,0.5,     1+0.5,0.5,1,1,
    1,1,1,0.5,0.5,    1,0.5,0.25,0.25,0.25,0.5,    0.5,0.5,0.5,0.25,0.5,1,
    0.5,0.5,0.5,0.5,1,1,    1,1,1,0.5,0.5,    1+0.5,0.5,1,1,
    1,1,1,0.5,0.5,    1.5,0.5,1,1,    1,1,1,1,
    0.5,0.5,1,1,0.5,0.5,    1.5,0.25,0.5,1,    1,1,1,1,
    1,1,1,1,    1,1,1,1,    0.5,0.5,1,1,0.5,0.5,
    1,0.5,0.5,1,1,    1,1,1,1,    1,1,1,1,
    0.5,0.5,1,1,0.5,0.5,    1,0.5,0.25,0.5,1,    1,1,1,0.5,0.5
};

int length;//这里定义一个变量，后面用来表示共有多少个音符
const byte ROWS = 4;
const byte COLS = 4;

char password[4] = { '1' , '2' , '3' , '4' };
char hexaKeys[ROWS][COLS] = {
    {'1','2','3','A'},
    {'4','5','6','B'},
    {'7','8','9','C'},
    {'*','0','#','D'}
};
byte rowPins[ROWS] = {11, 10, 9, 8};
byte colPins[COLS] = {7, 6, 5, 4};



//地图的初始位置
int posY = 1;
int posX = 2;

int iniposY = 1;
int iniposX = 2;
//当前进行关数
int NowMap = 0;

//initialize an instance of class NewKeypad
Keypad customKeypad = Keypad( makeKeymap(hexaKeys), rowPins, colPins, ROWS, COLS);

int ArriveFlag = 0;
int MusicFlag = 0;
//若通关成功，Flag = 1， 若Flag = 1，关卡数递增并重置Flag

void setup(){
    Serial.begin(9600);
    pinMode(12,OUTPUT);
    pinMode(3,OUTPUT);
    length = sizeof(tune)/sizeof(tune[0]);
}

void loop(){
    digitalWrite(12,HIGH);
    char Map[4][16][16] = {{
    { '1', '1', '1', '1', '1', '1', '1', '1', '1', '1', '1', '1', '1', '1', '1', '1' },
    { '1', '1', '0', '1', '1', '1', '1', '1', '1', '0', '1', '1', '1', '1', '1', '1' },
    { '1', '0', '0', '1', '1', '1', '1', '1', '1', '0', '1', '1', '1', '1', '1', '1' },
    { '1', '1', '0', '1', '1', '1', '1', '1', '1', '0', '1', '1', '1', '1', '1', '1' },
    { '1', '0', '0', '0', '1', '0', '0', '0', '0', '0', '0', '0', '0', '0', '1', '1' },
    { '1', '1', '1', '0', '1', '1', '1', '1', '0', '0', '1', '1', '1', '1', '1', '1' },
    { '1', '1', '1', '0', '1', '1', '1', '0', '0', '0', '0', '1', '1', '1', '1', '1' },
    { '1', '1', '1', '0', '1', '1', '1', '0', '1', '1', '0', '1', '1', '1', '1', '1' },
    { '1', '1', '1', '0', '1', '1', '0', '0', '1', '1', '0', '0', '1', '1', '1', '1' },
    { '1', '1', '1', '0', '1', '1', '0', '1', '1', '1', '1', '0', '1', '1', '1', '1' },
    { '1', '1', '0', '0', '0', '0', '0', '1', '1', '1', '1', '0', '0', '1', '1', '1' },
    { '1', '1', '0', '1', '0', '0', '1', '1', '1', '1', '1', '1', '3', '1', '1', '1' },
    { '1', '0', '0', '1', '0', '0', '1', '1', '1', '1', '1', '1', '1', '0', '0', '1' },
    { '1', '0', '1', '1', '1', '0', '0', '0', '0', '0', '0', '0', '0', '0', '1', '1' },
    { '1', '1', '1', '1', '1', '1', '1', '1', '1', '1', '1', '1', '1', '1', '1', '1' },
    { '1', '1', '1', '1', '1', '1', '1', '1', '1', '1', '1', '1', '1', '1', '1', '1' }
},{
    { '1', '1', '0', '1', '1', '1', '1', '1', '1', '1', '1', '1', '1', '1', '1', '1' },
    { '1', '0', '0', '0', '0', '0', '0', '1', '0', '0', '0', '0', '0', '0', '0', '1' },
    { '1', '0', '1', '1', '1', '1', '1', '1', '0', '1', '1', '1', '1', '1', '0', '1' },
    { '1', '0', '1', '0', '0', '0', '0', '0', '0', '0', '0', '0', '0', '1', '0', '1' },
    { '1', '0', '1', '0', '1', '1', '1', '1', '1', '1', '1', '1', '1', '1', '0', '1' },
    { '1', '0', '1', '0', '1', '0', '0', '0', '1', '0', '0', '0', '0', '1', '0', '1' },
    { '1', '0', '1', '0', '1', '0', '1', '1', '1', '0', '1', '0', '0', '0', '0', '1' },
    { '1', '1', '1', '0', '1', '0', '1', '3', '0', '0', '1', '0', '1', '1', '1', '1' },
    { '1', '0', '1', '0', '1', '0', '1', '1', '1', '1', '1', '1', '0', '0', '0', '1' },
    { '1', '0', '1', '0', '0', '0', '0', '0', '0', '0', '0', '1', '0', '1', '0', '0' },
    { '1', '0', '1', '1', '1', '1', '1', '0', '1', '1', '1', '1', '0', '1', '0', '1' },
    { '1', '0', '0', '0', '0', '0', '0', '0', '1', '0', '0', '0', '0', '1', '0', '1' },
    { '1', '0', '1', '1', '1', '1', '1', '1', '1', '1', '1', '1', '1', '1', '0', '1' },
    { '1', '0', '0', '0', '0', '0', '0', '0', '0', '0', '0', '0', '0', '0', '0', '1' },
    { '1', '1', '1', '1', '1', '1', '1', '1', '1', '1', '1', '1', '1', '1', '1', '1' },
    { '1', '1', '1', '1', '1', '1', '1', '1', '1', '1', '1', '1', '1', '1', '1', '1' }
},{
    { '1', '1', '1', '1', '1', '1', '1', '1', '1', '1', '1', '1', '1', '1', '1', '1' },
    { '1', '0', '0', '0', '0', '0', '0', '0', '0', '0', '0', '0', '0', '0', '0', '1' },
    { '1', '0', '0', '0', '0', '0', '0', '0', '0', '0', '0', '0', '0', '0', '0', '1' },
    { '1', '0', '0', '0', '0', '0', '0', '0', '0', '0', '0', '0', '0', '0', '0', '1' },
    { '1', '0', '0', '0', '0', '0', '0', '0', '0', '0', '0', '0', '0', '0', '0', '1' },
    { '1', '1', '1', '1', '1', '1', '1', '1', '1', '1', '1', '0', '0', '0', '1', '1' },
    { '1', '1', '1', '1', '1', '1', '1', '1', '1', '1', '1', '0', '0', '0', '1', '1' },
    { '1', '0', '0', '0', '0', '3', '1', '1', '1', '0', '0', '0', '0', '0', '0', '0' },
    { '1', '0', '1', '1', '1', '1', '1', '1', '1', '0', '0', '0', '0', '0', '0', '1' },
    { '1', '0', '1', '1', '1', '0', '0', '0', '0', '0', '0', '0', '0', '0', '0', '1' },
    { '1', '0', '1', '1', '1', '1', '1', '1', '1', '1', '1', '1', '1', '1', '0', '1' },
    { '1', '0', '1', '1', '1', '1', '1', '1', '1', '1', '1', '1', '1', '1', '0', '1' },
    { '1', '0', '0', '0', '0', '0', '0', '0', '0', '0', '0', '0', '0', '0', '0', '1' },
    { '1', '1', '1', '1', '1', '1', '1', '1', '1', '1', '1', '1', '1', '1', '1', '1' },
    { '1', '0', '1', '0', '1', '0', '1', '0', '1', '0', '1', '0', '1', '0', '1', '0' },
    { '0', '1', '0', '1', '0', '1', '0', '1', '0', '1', '0', '1', '0', '1', '0', '1' }
},{
    { '1', '1', '1', '1', '1', '1', '1', '1', '1', '1', '1', '1', '1', '1', '1', '1' },
    { '1', '0', '1', '0', '1', '0', '1', '0', '1', '0', '1', '0', '1', '0', '1', '1' },
    { '1', '0', '1', '0', '1', '0', '1', '0', '1', '0', '1', '0', '1', '0', '1', '1' },
    { '1', '0', '1', '0', '1', '0', '1', '0', '1', '0', '1', '0', '1', '0', '1', '1' },
    { '1', '0', '1', '0', '1', '0', '1', '0', '1', '0', '1', '0', '1', '0', '1', '1' },
    { '1', '0', '1', '0', '1', '0', '1', '0', '1', '0', '1', '0', '1', '0', '1', '1' },
    { '1', '0', '0', '0', '0', '0', '0', '0', '0', '0', '0', '0', '0', '0', '0', '1' },
    { '1', '1', '0', '1', '0', '1', '0', '1', '0', '1', '0', '1', '0', '1', '0', '1' },
    { '1', '1', '0', '1', '0', '1', '0', '1', '0', '1', '0', '1', '0', '1', '0', '1' },
    { '1', '1', '0', '1', '0', '1', '0', '1', '0', '1', '0', '1', '0', '1', '0', '1' },
    { '1', '1', '0', '1', '0', '1', '0', '1', '0', '1', '0', '1', '0', '1', '0', '1' },
    { '1', '1', '0', '1', '0', '1', '0', '1', '0', '1', '0', '1', '0', '1', '0', '1' },
    { '1', '1', '1', '1', '1', '1', '1', '1', '1', '1', '1', '1', '0', '1', '1', '1' },
    { '1', '0', '0', '0', '0', '0', '0', '0', '0', '0', '0', '0', '0', '1', '1', '1' },
    { '1', '0', '1', '1', '1', '1', '1', '1', '1', '1', '1', '1', '1', '1', '1', '1' },
    { '1', '3', '1', '1', '1', '1', '1', '1', '1', '1', '1', '1', '1', '1', '1', '1' },
  }
};
    
    if( Map[posY[NowMap]][posX[NowMap]] == '3' ){
        if( !ArriveFlag ){
            digitalWrite(12,LOW);
            delay(20);
            digitalWrite(12,HIGH);
            delay(20);
            digitalWrite(12,LOW);
            delay(20);
            digitalWrite(12,HIGH);
            delay(20);
            digitalWrite(12,LOW);
            delay(20);
            digitalWrite(12,HIGH);
            
            int KeyNUM = 0;
            while( KeyNUM != 4 ){
                char Key[4][4] = {{ '0','2','0','8' },
                { '0','4','0','7' },
                { '0','0','0','9' },
                { '1','0','1','0' }};
                char customKey = customKeypad.getKey();
                if(customKey){
                    digitalWrite(12,LOW);
                    delay(20);
                    digitalWrite(12,HIGH);
                    Serial.println(customKey);
                    if( customKey != Key[NowMap][KeyNUM] ){
                        posX = iniposX;
                        posY = iniposY;
                        break;
                    }
                    KeyNUM ++;
                }
            }
            //若完成循环
            if( KeyNUM == 4 ){
                ArriveFlag = 1;
                MusicFlag = 1;
            }
        }
        if( MusicFlag ){
            for(int x=(length/4)*NowMap;x<(length/4)*(NowMap+1);x++)
            {
                tone(12,tune[x]);
                delay(400*duration[x]);
                noTone(12);
            }
            MusicFlag = 0;
        }
        if( ArriveFlag == 1 && MusicFlag == 0 ){
            NowMap++;
            ArriveFlag = 0;
            posX[NowMap] = iniposX[NowMap];
            posY[NowMap] = iniposY[NowMap];
        }
    }
    if( NowMap == 4 ){
    for(int x=0;x<length;x++)
     {
                tone(12,tune[x]);
                delay(400*duration[x]);
                noTone(12);
     }
    }
    //遥杆所示坐标
    
    int X = analogRead(A1);
    int Y = analogRead(A0);
    int moveX = 0;
    int moveY = 0;
    if( X < 100 )
        moveX = -1;
    else if( X > 900 )
        moveX = 1;
    if( Y < 100 )
        moveY = 1;
    else if( Y > 900 )
        moveY = -1;
    
    if( posX[NowMap]+moveX > 15 ||
    posX[NowMap]+moveX < 0 ||
    posY[NowMap]+moveY > 15 ||
    posY[NowMap]+moveY < 0 ||
    Map[posY[NowMap]+moveY][posX[NowMap]+moveX] == '1' ){
        digitalWrite(12,LOW);
        delay(500);
        digitalWrite(12,HIGH);
        
    }//边界判断
    else {
        if( (moveX != 0 || moveY != 0 ) && moveY != moveX ){
            posX[NowMap] += moveX;
            posY[NowMap] += moveY;
            digitalWrite(12,LOW);
            delay(20);
            digitalWrite(12,HIGH);
        }
    }
    if( NowMap > 0){
        digitalWrite(3,0);
    }
    else
        digitalWrite(3,1);
    if( NowMap > 1){
        analogWrite(A3,0);
    }
    else
        analogWrite(A3,1023);
    if( NowMap > 2){
        analogWrite(A4,0);
    }
    else
        analogWrite(A4,1023);
    if( NowMap > 3){
        analogWrite(A5,0);
    }
    else
        analogWrite(A5,1023);
    delay(1000);
}
